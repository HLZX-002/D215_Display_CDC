## bsp/artinchip/drv/display/Kconfig.orientation
```kconfig
# Product orientation is opt-in so importing an unversioned old .config is safe.
config AIC_SCREEN_UNIFIED_ORIENTATION
    bool "Use product direction SN and unified geometry (new products)"
    default n
    depends on AIC_DISPLAY_DRV && AIC_SCREEN_PROFILE_PRESENT && !AIC_BOOTLOADER
    select AIC_USING_GE
    help
        Existing products must leave this disabled to preserve their serial
        number, framebuffer/LVGL settings and touch behaviour. New products
        enable this once, then select framebuffer rotation independently.
        The CDC SN stored in Flash is maintained by the developer and tells
        the host its direction and resolution.

config AIC_SCREEN_ORIENTATION_A
    bool
    default y if AIC_SCREEN_UNIFIED_ORIENTATION

config AIC_SCREEN_ORIENTATION_DEGREE
    int
    default 0

config AIC_SCREEN_ORIENTATION_LETTER
    string
    default "A"

config AIC_SCREEN_LOGICAL_WIDTH
    int
    default AIC_SCREEN_BASE_HEIGHT if AICFB_ROTATE_90 || AICFB_ROTATE_270
    default AIC_SCREEN_BASE_WIDTH

config AIC_SCREEN_LOGICAL_HEIGHT
    int
    default AIC_SCREEN_BASE_WIDTH if AICFB_ROTATE_90 || AICFB_ROTATE_270
    default AIC_SCREEN_BASE_HEIGHT

config AIC_SCREEN_LOGICAL_WIDTH_TEXT
    string
    default AIC_SCREEN_BASE_HEIGHT_TEXT if AICFB_ROTATE_90 || AICFB_ROTATE_270
    default AIC_SCREEN_BASE_WIDTH_TEXT

config AIC_SCREEN_LOGICAL_HEIGHT_TEXT
    string
    default AIC_SCREEN_BASE_WIDTH_TEXT if AICFB_ROTATE_90 || AICFB_ROTATE_270
    default AIC_SCREEN_BASE_HEIGHT_TEXT
```

## bsp/artinchip/drv/display/panel/Kconfig.timing
```kconfig
menu "display timing of simple panel"

    config PANEL_PIXELCLOCK
        int "pixelclock in MHZ"
        default 50 if AIC_SCREEN_VMAXA44_19
        default 90 if AIC_SCREEN_VMAXA51_12_3
        default 128 if AIC_SCREEN_VMAXC63_12_6
        default 52

    config PANEL_HACTIVE
        int "hactive" if !AIC_SCREEN_UNIFIED_ORIENTATION
        default AIC_SCREEN_BASE_WIDTH if AIC_SCREEN_UNIFIED_ORIENTATION
        default 1920 if AIC_SCREEN_VMAXA44_19 || AIC_SCREEN_VMAXA51_12_3
        default 2560 if AIC_SCREEN_VMAXC63_12_6
        default 1024

    config PANEL_VACTIVE
        int "vactive" if !AIC_SCREEN_UNIFIED_ORIENTATION
        default AIC_SCREEN_BASE_HEIGHT if AIC_SCREEN_UNIFIED_ORIENTATION
        default 360 if AIC_SCREEN_VMAXA44_19
        default 720 if AIC_SCREEN_VMAXA51_12_3
        default 666 if AIC_SCREEN_VMAXC63_12_6
        default 600

    config PANEL_HBP
        int "hback-porch"
        default 56 if AIC_SCREEN_VMAXA44_19 || AIC_SCREEN_VMAXA51_12_3
        default 80 if AIC_SCREEN_VMAXC63_12_6
    default 160

    config PANEL_HFP
        int "hfront-porch"
        default 140 if AIC_SCREEN_VMAXA44_19
        default 120 if AIC_SCREEN_VMAXA51_12_3
        default 48 if AIC_SCREEN_VMAXC63_12_6
    default 160

    config PANEL_HSW
        int "hsync-len"
        default 32 if AIC_SCREEN_VMAXA44_19 || AIC_SCREEN_VMAXA51_12_3 || AIC_SCREEN_VMAXC63_12_6
    default 20

    config PANEL_VBP
        int "vback-porch"
        default 8 if AIC_SCREEN_VMAXA44_19 || AIC_SCREEN_VMAXA51_12_3
        default 32 if AIC_SCREEN_VMAXC63_12_6
    default 12

    config PANEL_VFP
        int "vfront-porch"
        default 12 if AIC_SCREEN_VMAXA44_19 || AIC_SCREEN_VMAXA51_12_3
        default 80 if AIC_SCREEN_VMAXC63_12_6
    default 20

    config PANEL_VSW
        int "vsync-len"
        default 5 if AIC_SCREEN_VMAXA44_19 || AIC_SCREEN_VMAXA51_12_3
        default 6 if AIC_SCREEN_VMAXC63_12_6
    default 2
endmenu
```

## target/configs/d21x_d215-demo88-nor-dacai03_rt-thread_helloworld_defconfig
```kconfig
CONFIG_PRJ_DEFCONFIG_FILENAME="d21x_d215-demo88-nor-dacai03_rt-thread_helloworld_defconfig"
CONFIG_PRJ_CHIP="d21x"
CONFIG_PRJ_BOARD="d215-demo88-nor-dacai03"
CONFIG_PRJ_KERNEL="rt-thread"
CONFIG_PRJ_APP="helloworld"
CONFIG_AIC_USING_FS_IMAGE_0=y
CONFIG_AIC_USING_FS_IMAGE_TYPE_FATFS_FOR_0=y
CONFIG_AIC_FS_IMAGE_DIR_0="packages/third-party/cherryusb/tools/aic_usbdisplay/Windows"
CONFIG_AIC_FS_IMAGE_NAME_0="rodata.fatfs"
CONFIG_AIC_USING_FS_IMAGE_1=y
CONFIG_AIC_FS_IMAGE_DIR_1="packages/artinchip/lvgl-ui/aic_demo/usb_osd_demo/lvgl_src_nor"
CONFIG_AIC_FS_IMAGE_NAME_1="data.lfs"
CONFIG_LVGL_V_9=y
CONFIG_LPKG_LVGL_THREAD_STACK_SIZE=7168
CONFIG_AIC_LVGL_DEMO=y
CONFIG_AIC_LVGL_USB_OSD_DEMO=y
CONFIG_LV_DISPLAY_ROTATE_EN=y
CONFIG_LV_USB_OSD_SCREEN_LOCK_TIME=0
CONFIG_LV_USB_OSD_SETTINGS_WAKEUP_KEY=""
CONFIG_LVGL_STORAGE_PATH="/data/lvgl_data"
CONFIG_AIC_USING_UART5=y
CONFIG_AIC_USING_I2C0=y
CONFIG_AIC_USING_I2C3=y
CONFIG_AIC_USING_USB0=y
# CONFIG_AIC_USING_USB1 is not set
CONFIG_AIC_USING_QSPI0=y
CONFIG_AIC_QSPI0_DEVICE_SPINOR=y
CONFIG_AIC_USING_TSEN=y
CONFIG_AIC_DISP_MIPI_DSI=y
CONFIG_AIC_DSI_LEGACY_PACKET_CONFIG=y
CONFIG_AIC_PAN_DISPLAY=y
# CONFIG_AIC_DISP_BOOTUP_LOGO is not set
CONFIG_AICFB_ROTATE_90=y
CONFIG_AIC_PANEL_DSI_JD9365_DC03=y
CONFIG_AIC_USING_I2S0=y
CONFIG_AIC_USING_DMA=y
CONFIG_AIC_USING_WRI=y
CONFIG_AIC_USING_RTC=y
CONFIG_AIC_USING_WDT=y
CONFIG_AIC_DRAM_TOTAL_SIZE=0x4000000
CONFIG_AIC_DRAM_CMA_SIZE=0x3000000
CONFIG_AIC_INTERRUPTSTACK_SIZE=4096
CONFIG_AIC_USING_SID=y
CONFIG_IDLE_THREAD_STACK_SIZE=2048
# CONFIG_RT_USING_TIMER_SOFT is not set
# CONFIG_RT_KSERVICE_USING_STDLIB is not set
# CONFIG_RT_KPRINTF_USING_LONGLONG is not set
# CONFIG_RT_DEBUG is not set
CONFIG_RT_MEMHEAP_BSET_MODE=y
CONFIG_RT_USING_MEMHEAP_AS_HEAP=y
# CONFIG_RT_USING_MEMHEAP_AUTO_BINDING is not set
CONFIG_RT_USING_DEVICE_OPS=y
CONFIG_RT_CONSOLE_DEVICE_NAME="uart5"
CONFIG_RT_MAIN_THREAD_STACK_SIZE=4096
CONFIG_RT_USING_LEGACY=y
CONFIG_FINSH_HISTORY_LINES=1
CONFIG_DFS_FILESYSTEMS_MAX=8
CONFIG_RT_USING_DFS_MNTTABLE=y
CONFIG_RT_USING_DFS_ELMFAT=y
CONFIG_RT_DFS_ELM_LFN_UNICODE_2=y
CONFIG_RT_DFS_ELM_USE_EXFAT=y
CONFIG_RT_DFS_ELM_DRIVES=4
CONFIG_RT_USING_DFS_DEVFS=y
CONFIG_RT_USING_DFS_ROMFS=y
CONFIG_RT_USING_FAL=y
# CONFIG_FAL_DEBUG_CONFIG is not set
CONFIG_FAL_USING_SFUD_PORT=y
CONFIG_RT_USING_CAN=y
CONFIG_RT_CAN_USING_HDR=y
CONFIG_RT_I2C_DEBUG=y
CONFIG_RT_USING_ADC=y
CONFIG_RT_USING_PWM=y
CONFIG_RT_USING_PM=y
CONFIG_PM_USING_CUSTOM_CONFIG=y
CONFIG_PM_ENABLE_SUSPEND_SLEEP_MODE=y
CONFIG_PM_ENABLE_THRESHOLD_SLEEP_MODE=y
CONFIG_RT_MMCSD_STACK_SIZE=8192
CONFIG_RT_SFUD_USING_QSPI=y
CONFIG_RT_AUDIO_REPLAY_MP_BLOCK_SIZE=192
CONFIG_RT_AUDIO_REPLAY_MP_BLOCK_COUNT=20
CONFIG_RT_USING_TOUCH=y
CONFIG_RT_TOUCH_PIN_IRQ=y
CONFIG_RT_USING_POSIX_FS=y
CONFIG_RT_USING_ULOG=y
CONFIG_ULOG_OUTPUT_LVL_I=y
CONFIG_ULOG_TIME_USING_TIMESTAMP=y
CONFIG_ULOG_USING_FILTER=y
CONFIG_LPKG_USING_CPU_USAGE=y
CONFIG_LPKG_USING_CHERRYUSB=y
CONFIG_LPKG_CHERRYUSB_DEVICE=y
CONFIG_LPKG_CHERRYUSB_DEVICE_COMPOSITE=y
CONFIG_LPKG_CHERRYUSB_DEVICE_COMPOSITE_SERIALNUMBER=y
CONFIG_LPKG_USING_COMP_HID_TABLE1=y
CONFIG_LPKG_CHERRYUSB_DYNAMIC_REGISTRATION_MODE=y
CONFIG_LPKG_CHERRYUSB_AIC_DISP_DR=y
CONFIG_LPKG_CHERRYUSB_DEVICE_HID_TOUCH_TEMPLATE=y
# CONFIG_USBD_MSC_STORAGE_USING_HOTPLUG is not set
CONFIG_USBDEV_MSC_READ_ONLY=y
CONFIG_MSC_STORAGE_PATH="/rodata"
CONFIG_AIC_USB_DISP_INIT_DELAY_MS=4000
CONFIG_LPKG_USING_LITTLEFS=y
CONFIG_LFS_READ_SIZE=2048
CONFIG_LFS_PROG_SIZE=2048
CONFIG_LPKG_USING_I2C_TOOLS=y
CONFIG_AIC_MPP_PLAYER_INTERFACE=y
CONFIG_AIC_GPIO_IRQ_DRV_EN=y
CONFIG_AIC_USING_TOUCH=y
CONFIG_AIC_TOUCH_PANEL_I2C_CHAN="i2c0"
CONFIG_AIC_TOUCH_PANEL_RST_PIN="PD.8"
CONFIG_AIC_TOUCH_PANEL_INT_PIN="PD.9"
CONFIG_AIC_TOUCH_X_COORDINATE_RANGE=1280
CONFIG_AIC_TOUCH_Y_COORDINATE_RANGE=800
CONFIG_AIC_SCREEN_REAL_X_RESOLUTION=800
CONFIG_AIC_SCREEN_REAL_Y_RESOLUTION=1280
CONFIG_AIC_SCREEN_RELATIVE_ROTATION_DEGREE=270
CONFIG_AIC_I2S_CODEC_ES8388=y
# CONFIG_AIC_I2S_CODEC_TLV320 is not set
CONFIG_AIC_I2S_CODEC_ES8388_I2C="i2c3"
CONFIG_AIC_I2S_CODEC_PA_PIN="PA.7"
CONFIG_AIC_DMA_DRV_TEST=y
CONFIG_AIC_RTC_DRV_TEST=y
```
